/**********************与飞电子开发板例程************************
*  名称：本程序为蜂鸣器的基本驱动示例，
    首先 用杜邦线 将单片机的P23口与电机驱动电路的 J1 (FM)插针相连
     实验板唱歌实验
*  公司：与飞电子
*  淘宝：http://yfmcu.taobao.com       
*  编写：与飞
*  日期：2013-1-4
*   QQ : 112990183
*  晶振:11.0592MHZ
*  说明：免费开源，不提供源代码分析
******************************************************************/

#include <at89x52.h>
#define uchar unsigned char
bit flag; //标志音乐输出脚电平的高低
uchar ptr = 0; //取音符
uchar high; //计数器高位
uchar low; //计数器低位
// 本曲谱为 "music_test-这就是爱吗",前两个十六进制表示发声频率,后一个表示发声时间,255,255 表示休止符
// 0x00 表示结束
uchar code music[] = {
246,209,255,249,30,127,249,197,127,250,137,127,249,197,127,250,137,127,249,30,127,249,197,255,255,255,255,
249,30,127,248,182,127,249,30,127,247,209,127,248,182,255,255,255,255,247,209,127,248,182,127,249,30,127,251,233,64,251,104,364,246,
209,127,249,30,127,249,197,127,250,137,127,250,216,127,250,137,127,251,233,127,250,137,64,249,197,64,249,197,255,249,30,127,249,197,
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216,64,250,137,64,						 																	   
0//结束
};

void Init(void); //初始化函数
void DelayMs(unsigned int time); //毫秒级延时函数

void main()
{
	uchar time;
	Init();
	TH0 = high;
	TL0 = low;
	while (1)
	{
		if (music[ptr] != 255 && music[ptr] != 0)//判断是否是正常音符
		{
			TR0 = 0;
			P2_3 = 1;
			DelayMs(10); //间歇
			TR0 = 1;
			high = music[ptr]; //取设置频率数值的高8 位
			low = music[ptr + 1]; //取设置频率数值的低8 位
			time = music[ptr + 2]; //取发声时间
			P1=0x00;
			DelayMs(time);
			P1=0xff;
			ptr += 3;
		}
		else if (music[ptr] == 255) //判断是否是休止符
		{
			time = music[ptr + 2];
			DelayMs(time);
			ptr += 3;
		}
		
		else //结束符,停止2 秒后继续
		{
			TR0 = 0;
			P2_3 = 1;
			DelayMs(2000);
			ptr = 0;
		}
	}
}
/*********************************************************************************
* 名称：Count1(void) interrupt 1
* 功能：设置计时器0 溢出中断,每中断一次改变P2_3 引脚电平
*********************************************************************************/
void Count1(void) interrupt 1
{
	TH0 = high;
	TL0 = low;
	if (flag == 0) //改变P2_3 引脚电平
	{
		P2_3 = 0;
		flag = 1;
	}
	else
	{
		P2_3 = 1;
		flag = 0;
	}
}
/*********************************************************************************
* 名称：Init()
* 功能：设置计数器0 工作方式,16 位计数,溢出中断方式
**********************************************************************************/
void Init()
{
	TMOD = 0x01; //定时器0 处于计时方式,16 位
	EA = 1;
	ET0 = 1; //定时器0 溢出中断
}
/*********************************************************************************
* 名称：DelayMs(unsigned int time)
* 功能：延时time * 1ms 时间
*********************************************************************************/
void DelayMs(unsigned int time)
{
	unsigned int i;
	unsigned int j;
	for (j =0; j < time; j++) //每个循环 约 3ms
	{
		for (i =0; i < 363; i++)
		{;}
	}
}