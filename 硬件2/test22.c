/**********************与飞电子开发板例程************************
*  名称：8*8点阵显示
   内容：和数码管显示方式相同，这里使用P0口和P2口
   注意：点阵引脚的顺序，在开发板上有标点阵的引脚序号，不要插反了
*  公司：与飞电子
*  淘宝：http://yfmcu.taobao.com       
*  编写：与飞
*  日期：2013-1-4
*   QQ : 112990183
*  晶振:11.0592MHZ
*  说明：免费开源，不提供源代码分析
******************************************************************/

#include<reg52.h> //包含头文件，一般情况不需要改动，头文件包含特殊功能寄存器的定义

unsigned char const yufei[]={0x00,0x6C,0x92,0x82,0x44,0x28,0x10,0x00};// 心的形状
unsigned char code wei[]={0x7f,0xbf,0xdf,0xef,0xf7,0xfb,0xfd,0xfe};   //分别对应相应的段亮

sbit DU = P2^6;
sbit WE = P2^7;
/*------------------------------------------------
                    关数码管
------------------------------------------------*/
void cmg88()
{
DU=1;  
P0=0X00;
DU=0;

}
/*------------------------------------------------
                    延时程序
------------------------------------------------*/
void delay(unsigned int cnt)
{
 while(--cnt);
}
/*------------------------------------------------
                 主程序
------------------------------------------------*/
main()
{
 unsigned char i;

 while(1)
      {
 	   cmg88();	//关闭数码管
       P0=yufei[i];//取显示数据
	   P2=wei[i];  //取位码
	   delay(200); //扫描间隙延时，时间太长会造成闪烁，太短会重影
	   i++;
	   if(8==i)    
	     i=0;
      }
}